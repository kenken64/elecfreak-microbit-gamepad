/*
 * main.cpp - GENERATED by the gamepad block editor. Don't edit it by hand:
 * change the blocks instead (python tools/blocks_editor.py). The blocks are
 * saved in blocks/gamepad.json; each one is a gp_*() call from gp_runtime.h.
 */
#include <Arduino.h>

#include "gp_runtime.h"

/* on start */
void setup()
{
	gp_boot(); /* serial log, LED screen, Joystick:bit inputs */
	gp_bluetooth_begin("micro:bit Gamepad");
	if (gp_ab_held_at_start()) {
		gp_forget_all_pairings();
		gp_show_icon(GP_ICON_CROSS);
		gp_wait_ab_released();
	}
}

/* every 10 ms */
void loop()
{
	gp_poll(); /* keep Bluetooth running */
	if (!gp_every(10)) {
		return;
	}
	gp_inputs_update(); /* read keys, buttons and stick; start an empty report */

	if (gp_key_pressed(1)) {
		gp_press(1);
	}
	if (gp_key_pressed(2)) {
		gp_press(2);
	}
	if (gp_key_pressed(3)) {
		gp_press(3);
	}
	if (gp_key_pressed(4)) {
		gp_press(4);
	}
	if (gp_key_pressed(5)) {
		gp_press(5);
	}
	if (gp_key_pressed(6)) {
		gp_press(6);
	}
	gp_set_axis(GP_AXIS_X, gp_stick(GP_AXIS_X));
	if (gp_stick_connected(GP_AXIS_Y)) {
		gp_set_axis(GP_AXIS_Y, gp_stick(GP_AXIS_Y));
		if (gp_button_pressed('A')) {
			gp_press(7);
		}
		if (gp_button_pressed('B')) {
			gp_press(8);
		}
	} else {
		if (gp_button_pressed('A')) {
			gp_set_axis(GP_AXIS_Y, -127);
		} else if (gp_button_pressed('B')) {
			gp_set_axis(GP_AXIS_Y, 127);
		}
	}
	gp_report_send();
	gp_status_show();
}
